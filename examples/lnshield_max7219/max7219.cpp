#include<SPI.h>
static const int clk = 13;
static const int cs = 10;
static const int din = 11;
static const int scroll_speed = 50;
static const unsigned char disp1[37][8] = {
    {0x3C, 0x42, 0x46, 0x4A, 0x52, 0x62, 0x42, 0x3C}, //0
    {0x08, 0x18, 0x28, 0x08, 0x08, 0x08, 0x08, 0x08}, //1
    {0x7E, 0x2, 0x2, 0x7E, 0x40, 0x40, 0x40, 0x7E}, //2
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    {0x0, 0x0, 0x0, 0x0, 0x0, 0x0, 0x0, 0x0}, //null36
};
//LED DISP DATA RAM
static unsigned char dispA[4][8] = {
    {0, 0, 0, 0, 0, 0, 0, 0},
    {0, 0, 0, 0, 0, 0, 0, 0},
    {0, 0, 0, 0, 0, 0, 0, 0},
    {0, 0, 0, 0, 0, 0, 0, 0},
};

static void scrool_disp(int moji);
static void DATA_set();
static void disp_view();
static void Write_Max7219(char address, char dat);
static void Init_MAX7219(void);
static void Write_Max7219int(char address, char dat);


void max7219_setup()
{
    pinMode(cs, OUTPUT);
    pinMode(clk, OUTPUT);
    pinMode(din, OUTPUT);
    SPI.begin();
    SPI.setBitOrder(MSBFIRST);
    SPI.setDataMode(0);
    Init_MAX7219();
    scrool_disp(' ');
}

void max7219_scroll_string(const char *str)
{
    int len = strlen(str);
    for (int i = 0; i < len; i++) {
        scrool_disp(str[i]);
    }
    for (int i = 0; i < 4; i++) {
        scrool_disp(' ');
    }
}

static void scrool_disp(int moji)
{
    int MOJI;
    if (('0' <= moji) && (moji <= '9')) {
        MOJI = moji - '0';
    } else if (('A' <= moji) && (moji <= 'Z')) {
        MOJI = moji - 'A' + 10;
    } else {
        MOJI = 36;
    }
    int keta = 0x80;
    //---disp set---
    for (int j = 0; j < 8; j++) {
        DATA_set();    //LED1,2,3 DATA SET
        for (int i = 0; i < 8; i++) {
            dispA[0][i] = dispA[0][i] << 1; //left shift
        }
        for (int i = 0; i < 8; i++) { //LED0 DATA SET
            if ((disp1[MOJI][i]&keta) > 0) {
                dispA[0][i] = dispA[0][i] + 1;
            } else {
                dispA[0][i] = dispA[0][i] + 0;
            }
        }
        keta = keta >> 1;
        disp_view();  //LED0 to LED3 view
    }
}

static void DATA_set() //LED1,2,3 DATA SET
{
    for (int j = 3; j > 0 ; j--) {
        for (int i = 0; i < 8; i++) {
            dispA[j][i] = dispA[j][i] << 1; //left shift
        }
        for (int i = 0; i < 8; i++) {
            if ((dispA[j - 1][i] & 0x80) > 0) {
                dispA[j][i] = dispA[j][i] + 1;
            } else {
                dispA[j][i] = dispA[j][i] + 0;
            }
        }
    }
}

static void disp_view()
{
    for (int i = 1; i < 9; i++) {
        digitalWrite(cs, 0);
        Write_Max7219(i, (dispA)[3][i - 1]);
        Write_Max7219(i, (dispA)[2][i - 1]);
        Write_Max7219(i, (dispA)[1][i - 1]);
        Write_Max7219(i, (dispA)[0][i - 1]);
        digitalWrite(cs, 1);
    }
    digitalWrite(cs, 0);
    delay(scroll_speed);
}

static void Write_Max7219(char address, char dat)
{
    SPI.transfer(address);
    SPI.transfer(dat);
}

static void Init_MAX7219(void)
{
    Write_Max7219int(0x09, 0x00);
    Write_Max7219int(0x0a, 0x04);
    Write_Max7219int(0x0b, 0x07);
    Write_Max7219int(0x0c, 0x01);
    Write_Max7219int(0x0f, 0x00);
    Write_Max7219int(0x00, 0x00);//shift data
    Write_Max7219int(0x00, 0x00);//shift data
    Write_Max7219int(0x00, 0x00);//shift data
    delay(100);
}

static void Write_Max7219int(char address, char dat)
{
    digitalWrite(cs, 0);
    SPI.transfer(address);
    SPI.transfer(dat);
    digitalWrite(cs, 1);
}
